## config/boards/arm/adv360/Kconfig
```kconfig
# SPDX-License-Identifier: MIT

config BOARD_ENABLE_DCDC
	bool "Enable DCDC mode"
	select SOC_DCDC_NRF52X
	default y
	depends on BOARD_ADV360_LEFT || BOARD_ADV360_RIGHT

CONFIG_ZMK_COMBO_MAX_COMBOS_PER_KEY=12
CONFIG_ZMK_COMBO_MAX_PRESSED_COMBOS=1
CONFIG_ZMK_COMBO_MAX_KEYS_PER_COMBO=2
```
